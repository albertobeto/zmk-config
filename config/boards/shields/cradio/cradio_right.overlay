/*
 * Copyright (c) 2020 Pete Johanson
 *
 * SPDX-License-Identifier: MIT
 */

#include "cradio.dtsi"
#include <dt-bindings/zmk/pointing.h>
#include <input/processors.dtsi>
#include <zephyr/dt-bindings/input/input-event-codes.h>

&mmv {
  acceleration-exponent = <1>;          // 1
  time-to-max-speed-ms = <5000>;         // 300
  delay-ms = <0>;                       // 0
};

&msc {
  acceleration-exponent = <0>;          // 0
  time-to-max-speed-ms = <3000>;         // 300
  delay-ms = <0>;                       // 0
};


&default_transform {
    col-offset = <18>;
};

&kscan0 {
        compatible = "zmk,kscan-gpio-direct";
        wakeup-source;
    input-gpios
    = 
      <&pro_micro 16 (GPIO_ACTIVE_LOW | GPIO_PULL_UP)>  
    , <&pro_micro 14 (GPIO_ACTIVE_LOW | GPIO_PULL_UP)> 
    , <&pro_micro 15 (GPIO_ACTIVE_LOW | GPIO_PULL_UP)> 
    , <&pro_micro 18 (GPIO_ACTIVE_LOW | GPIO_PULL_UP)> 
    , <&pro_micro 19 (GPIO_ACTIVE_LOW | GPIO_PULL_UP)> 


    , <&pro_micro 4 (GPIO_ACTIVE_LOW | GPIO_PULL_UP)> 
    , <&pro_micro 3 (GPIO_ACTIVE_LOW | GPIO_PULL_UP)> 
    , <&pro_micro 2 (GPIO_ACTIVE_LOW | GPIO_PULL_UP)> 
    , <&pro_micro 0 (GPIO_ACTIVE_LOW | GPIO_PULL_UP)>
    , <&pro_micro 1 (GPIO_ACTIVE_LOW | GPIO_PULL_UP)> 


    , <&pro_micro 9 (GPIO_ACTIVE_LOW | GPIO_PULL_UP)> 
    , <&pro_micro 8 (GPIO_ACTIVE_LOW | GPIO_PULL_UP)>
    , <&pro_micro 7 (GPIO_ACTIVE_LOW | GPIO_PULL_UP)> 
    , <&pro_micro 6 (GPIO_ACTIVE_LOW | GPIO_PULL_UP)> 
    , <&pro_micro 5 (GPIO_ACTIVE_LOW | GPIO_PULL_UP)> 

    , <&pro_micro  23 (GPIO_ACTIVE_LOW | GPIO_PULL_UP)>
    , <&pro_micro  24 (GPIO_ACTIVE_LOW | GPIO_PULL_UP)>
    , <&pro_micro  10 (GPIO_ACTIVE_LOW | GPIO_PULL_UP)>

    , <&pro_micro  20 (GPIO_ACTIVE_LOW | GPIO_PULL_UP)>
    , <&pro_micro  21 (GPIO_ACTIVE_LOW | GPIO_PULL_UP)>
    , <&pro_micro  22 (GPIO_ACTIVE_LOW | GPIO_PULL_UP)>




    ;
};
