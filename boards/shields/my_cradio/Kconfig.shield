## boards/shields/my_cradio/Kconfig.shield
```kconfig
# Copyright (c) 2020 The ZMK Contributors
# SPDX-License-Identifier: MIT

config SHIELD_MY_CRADIO_LEFT
    def_bool $(shields_list_contains,my_cradio_left)

config SHIELD_MY_CRADIO_RIGHT
    def_bool $(shields_list_contains,my_cradio_right)
```
